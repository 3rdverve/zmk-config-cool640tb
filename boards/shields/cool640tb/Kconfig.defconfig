## modules/dts/bindings/sensor/maxim,max17048.yaml
```yaml
description: Maxim MAX17048 fuel gauge
compatible: "maxim,max17048"
include: i2c-device.yaml
```

## modules/max17048/Kconfig
```kconfig
config FUEL_GAUGE
    bool "Fuel gauge support"

config FUEL_GAUGE_MAX17048
    bool "MAX17048 fuel gauge"
    depends on I2C
    select FUEL_GAUGE
    help
      Enable support for MAX17048 fuel gauge.
```

## modules/vbat_enable/Kconfig
```kconfig
menu "VBAT enable module"
config VBAT_ENABLE
    bool "Enable VBAT divider on XIAO BLE"
    default y
endmenu
```
